## layers/meta-stacking/conf/layer.conf
```bitbake
# We have a conf and classes directory, add to BBPATH
BBPATH .= ":${LAYERDIR}"

# We have recipes-* directories, add to BBFILES
BBFILES += "${LAYERDIR}/recipes-*/*/*.bb \
            ${LAYERDIR}/recipes-*/*/*.bbappend"

BBFILE_COLLECTIONS += "meta-stacking"
BBFILE_PATTERN_meta-stacking = "^${LAYERDIR}/"
BBFILE_PRIORITY_meta-stacking = "6"

LAYERDEPENDS_meta-stacking = "core"
LAYERSERIES_COMPAT_meta-stacking = "dunfell"
```
